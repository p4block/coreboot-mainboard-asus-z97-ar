## Kconfig
```kconfig
if BOARD_ASUS_Z97_AR

config BOARD_SPECIFIC_OPTIONS
    def_bool y
    select CPU_INTEL_HASWELL
    select NORTHBRIDGE_INTEL_HASWELL
    select SOUTHBRIDGE_INTEL_LYNXPOINT
    select BOARD_ROMSIZE_KB_8192
    select HAVE_ACPI_TABLES
    select HAVE_ACPI_RESUME
    select HAVE_SMI_HANDLER
    select INTEL_INT15
    select SERIRQ_CONTINUOUS_MODE
    select SUPERIO_NUVOTON_NCT6779D

config HAVE_IFD_BIN
    bool
    default n

config HAVE_ME_BIN
    bool
    default n

config MAINBOARD_DIR
    string
    default asus/z97-ar

config MAINBOARD_PART_NUMBER
    string
    default "Z97-AR"

config VGA_BIOS_FILE
    string
    default "pci8086,0166.rom"

config MAINBOARD_PCI_SUBSYSTEM_DEVICE_ID
    hex
    default 0x8534

config MAINBOARD_PCI_SUBSYSTEM_VENDOR_ID
    hex
    default 0x1043

config DRAM_RESET_GATE_GPIO # FIXME: check this
    int
    default 60

config MAX_CPUS
    int
    default 8

endif
```
